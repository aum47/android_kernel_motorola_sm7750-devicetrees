// SPDX-License-Identifier: BSD-3-Clause
/*
 * Copyright (c) 2024 Qualcomm Innovation Center, Inc. All rights reserved.
 */

/dts-v1/;
/plugin/;

#include "kera-wcn7750-bt.dtsi"

/ {
	model = "qogir";
	compatible = "qcom,kera-mtp", "qcom,kera", "qcom,mtp",
				"qcom,kera-qrd", "qcom,qrd", "qcom,kera-rcm",
				"qcom,rcm";
	qcom,msm-id = <686 0x10000>, <659 0x10000>;
	qcom,board-id = <0x44 0x9000>, <0x44 0x9200>;
};
