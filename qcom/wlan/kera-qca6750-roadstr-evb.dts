// SPDX-License-Identifier: BSD-3-Clause
/*
 * Copyright (c) 2024 Qualcomm Innovation Center, Inc. All rights reserved.
 */

/dts-v1/;
/plugin/;

#include "kera-qca6750.dtsi"

/ {
	model = "Qualcomm Technologies, Inc. Kera SoC + MSL WLAN";
	compatible = "qcom,kera";
	qcom,msm-id = <686 0x10000>, <659 0x10000>;
	qcom,board-id = <0x41 0x9000>, <0x41 0xA100>, <0x441 0xA100>;
};
